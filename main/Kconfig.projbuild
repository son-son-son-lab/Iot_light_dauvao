## main/Kconfig.projbuild
```kconfig
menu "I2C Configuration"

    config I2C_MASTER_SCL
        int "I2C SCL GPIO"
        range 0 33
        default 22
        help
            GPIO number used for the I2C master clock.

    config I2C_MASTER_SDA
        int "I2C SDA GPIO"
        range 0 33
        default 21
        help
            GPIO number used for I2C master data.

    config I2C_MASTER_FREQUENCY
        int "I2C master frequency (Hz)"
        range 10000 400000
        default 100000
        help
            I2C master clock frequency.

endmenu
```
